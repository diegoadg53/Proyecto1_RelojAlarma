; Universidad del Valle de Guatemala ; IE2023: Programación de Microcontroladores
; Proyecto1_RelojAlarma.asm
; Autor: Diego Duarte 22426
; Proyecto: Proyecto 1
; Hardware: ATMEGA328P
; Creado: 14/02/2024
; Última modificación: 14/02/2024

;EL REGISTRO MODE CONTIENE 4 BANDERAS CORRESPONDIENTES A LOS 4 DIFERENTES MODOS
;EN TODO MOMENTO, SOLO UNA DE LAS CUATRO BANDERAS PERMANECE ENCENDIDA
; EL BIT 0 CORRESPONDE AL MODO HORA
; EL BIT 1 CORRESPONDE AL MODO FECHA
; EL BIT 2 CORRESPONDE AL MODO AÑO
; EL BIT 3 CORRESPONDE AL MODO ALARMA

;EL REGISTRO CONFIGURE TIENE 3 BANDERAS EN SUS BITS MENOS SIGNIFICATIVOS:
;EL BIT 0 INDICA SI SE ENCUENTRA EN MODO CONFIGURACION O NO
;	CUANDO ESTE ESTÁ ENCENDIDO, SIGNIFICA QUE SE ESTÁ CONFIGURANDO EL VALOR CORRESPONDIENTE AL MODO
;	CUANDO ESTE ESTÁ APAGADO, SIGNIFICA QUE NO SE ESTÁ CONFIGURANDO
;EL BIT 1 INDICA QUE SE ESTÁN CONFIGURANDO LOS DOS DISPLAYS DE LA DERECHA CUANDO ESTÁ EN 1
;EL BIT 2 INDICA QUE SE ESTÁN CONFIGURANDO LOS DOS DISPLAYS DE LA IZQUIERDA CUANDO ESTÁ EN 0
;EL ESTADO DE LOS BITS 1 Y 2 ES IRRELEVANTE CUANDO SE ESTÁ CONFIGURANDO EL AÑO

;EL REGISTRO BANDERA_ALARMA_BOTONES_SEGUNDO CONTIENE BANDERAS PARA EL USO DE ALARMA, ESTADO DE BOTONES Y EL PASO DE UN SEGUNDO
;EL BIT 0 INDICA QUE HA PASADO UN SEGUNDO CUANDO ESTÁ ENCENDIDO
;	ESTE SE ENCIENDE EN LA INTERRUPCIÓN DEL TIMER0 LUEGO DE QUE HAYA PASADO 1 SEGUNDO
;	SE APAGA EN EL LOOP PRINCIPAL LUEGO DE QUE SE VERIFICO QUE ESTABA ENCENDIDO. INMEDIATAMENTE DESPUÉS SE HACE LA SUMA CORRESPONDIENTE AL PASO DEL TIEMPO
;EL BIT 1 INDICA QUE SE TIENE QUE HACER LA ACCION DE INCREMENTAR EL VALOR CORRESPONDIENTE AL MODO CUANDO LA CONFIGURACION ESTÁ ACTIVA
;	SE ENCIENDE EN LA INTERRUPCIÓN DEL PINC CUANDO EL PC4 FUE PRESIONADO SOLO SI EL MODO CONFIGURACIÓN ESTÁ ENCENDIDO
;	SE APAGA EN EL LOOP PRINCIPAL LUEGO DE QUE SE VERIFICO QUE ESTABA ENCENDIDO. INMEDIATAMENTE DESPUÉS SE HACE EL INCREMENTO CORRESPONDIENTE DEL VALOR SEGÚN EL MODO EN EL QUE SE ESTÉ
;EL BIT 2 INDICA QUE SE TIENE QUE HACER LA ACCION DE DECREMENTAR EL VALOR CORRESPONDIENTE AL MODO CUANDO LA CONFIGURACION ESTÁ ACTIVA
;	SE ENCIENDE EN LA INTERRUPCIÓN DEL PINC CUANDO EL PC3 FUE PRESIONADO SOLO SI EL MODO CONFIGURACIÓN ESTÁ ENCENDIDO
;	SE APAGA EN EL LOOP PRINCIPAL LUEGO DE QUE SE VERIFICO QUE ESTABA ENCENDIDO. INMEDIATAMENTE DESPUÉS SE HACE EL DECREMENTO CORRESPONDIENTE DEL VALOR SEGÚN EL MODO EN EL QUE SE ESTÉ
;EL BIT 3 INDICA QUE LA ALARMA ESTÁ ACTIVA
;	EL VALOR DE ESTA SE ALTERNA EN LA INTERRUPCIÓN DEL PINC CUANDO EL PC4 FUE PRESIONADO SI EL MODO CONFIGURACION ESTÁ APAGADO Y EL MODO ESTÁ EN ALARMA
;	CUANDO LA ALARMA ESTA SONANDO, EL BIT SE APAGA EN LA INTERRUPCIÓN DEL PINC CUANDO CUALQUIERA DE LOS BOTONES A SIDO PRESIONADO
;EL BIT 4 INDICA QUE LA HORA HA LLEGADO AL VALOR DE ALARMA
;	EL BIT SE ENCIENDE EN EL LOOP PRINCIPAL LUEGO DE COMPARAR QUE LA HORA ES IGUAL A LA HORA DE LA ALARMA
;	EL BIT SE APAGA EN LA INTERRUPCIÓN DEL PINC CUANDO CUALQUIERA DE LOS BOTONES A SIDO PRESIONADO

;EL REGISTRO ALTERNADOR_LEDS TIENE UNA BANDERA EN EL BIT 0
;	EL VALOR DE ESTE SE ALTERNA EN LA INTERRUPCIÓN DEL TIMER0 CADA 500MS
;	ESTE REGISTRO TIENE MÚLTIPLES PROPÓSITOS:
;	INDICA EL PASO DE 1 SEGUNDO CUANDO SU VALOR HA CAMBIADO 2 VECES
;	ALTERNA LAS LEDS DE EN MEDIO DE LOS DISPLAYS CUANDO SE ENCUENTRA EN MODO HORA
;	CUANDO EL MODO CONFIGURACIÓN ESTÁ ACTIVA, ALTERNA EL PAR DE DISPLAYS QUE SE ESTÁN CONFIGURANDO (SI SE ENCUENTRA EN MODO AÑO, ALTERNA TODOS LOS DISPLAYS)
;	CUANDO LA ALARMA ESTÁ SONANDO, ALTERNA EL BUZZER

;EL REGISTRO ALTERNADOR_DISPLAYS TIENE 5 BANDERAS CORRESPONDIENTES A LOS 5 TRANSISTORES
;	EN TODO MOMENTO, UNA SOLA BANDERA ESTÁ ENCENDIDA, MIENTRAS QUE EL RESTO ESTÁN APAGADAS
;	CUANDO LA BANDERA CORRESPONDIENTE ESTÁ ENCENDIDA, SE ENCIENDE EL TRANSISTOR

;LOS MINUTOS, HORAS, DIAS, MESES, HORA DE ALARMA Y MINUTO DE ALARMA TIENEN 3 ESPACIOS RESERVADOS EN LA IRAM POR CADA UNO
;UN REGISTRO CONTIENE EL VALOR COMPLETO, LO CUAL SIRVE PARA LAS COMPARACIONES CORRESPONDIENTES QUE SE NECESITAN HACER EN DIFERENTES CASOS
;LOS OTROS DOS REGISTROS CONTIENEN LAS UNIDADES Y DECENAS DEL VALOR, LOS CUALES LUEGO SE CARGAN A LOS DISPLAYS CORRESPONDIENTES

;EL AÑO TIENE 6 ESPACIOS RESERVADOS EN LA IRAM
;UN REGISTRO CORRESPONDE AL VALOR DE LAS DECENAS Y UNIDADES (PARTE BAJA)
;OTRO REGISTRO CORRESPONDE AL VALOR DE LAS CENTENAS Y MILLARES (PARTE ALTA)
;LOS OTROS 4 REGISTROS CONTIENEN CADA UNO LAS UNIDADES, DECENAS, CENTENAS Y MILLARES PARA EL MUESTREO EN LOS DISPLAYS

;TAMBIEN SE TIENE UN ESPACIO RESERVADO QUE DETERMINA SI EL AÑO EN QUE SE ENCUENTRA ES BISIESTO O NO
;ESTE REGISTRO SE INICIALIZA EN 0 PORQUE EL AÑO 2024 ES BISIESTO
;SU VALOR SE INCREMENTA O DECREMENTA CONFORME SE ALTERA LA UNIDAD DE LOS AÑOS. CUANDO BISIESTO LLEGA A 4, SE REINICIA A 0
;CUANDO BISIESTO VALE 4, SIGNIFICA QUE EL AÑO ES BISIESTO, DE LO CONTRARIO NO ES BISIESTO
;ESTE DETERMINA SI EN FEBRERO SE CUENTA HASTA 29 O HASTA 28

;LOS REGISTROS R16, R17 Y R18 SE UTILIZAN VARIABLES DE MULTIUSOS

.include "M328PDEF.inc"
.CSEG
.DEF BANDERA_ALARMA_BOTONES_SEGUNDO = R19
.DEF CONTADOR_TIMER0 = R20
.DEF MODE = R21
.DEF CONFIGURE = R22
.EQU MINUTE_U = 0X01FF
.EQU MINUTE_D = 0X0200
.EQU HOUR_U = 0X0201
.EQU HOUR_D = 0X0202
.EQU DAY_U = 0X0203
.EQU DAY_D = 0X0204
.EQU MONTH_U = 0X0205
.EQU MONTH_D = 0X0206
.EQU YEAR_U = 0X0207
.EQU YEAR_D = 0X0208
.EQU YEAR_C = 0X0209
.EQU YEAR_M = 0X020A
.EQU MINUTE = 0X020B
.EQU HOUR = 0X020C
.EQU DAY = 0X020D
.EQU MONTH = 0X020E
.EQU BISIESTO = 0X020F
.EQU SECONDS = 0X0210
.EQU YEAR_LOW = 0X0211
.EQU YEAR_HIGH = 0X0212
.EQU ALARM_MINUTE = 0X0213
.EQU ALARM_MINUTE_U = 0X0214
.EQU ALARM_MINUTE_D = 0X0215
.EQU ALARM_HOUR = 0X0216
.EQU ALARM_HOUR_U = 0X0217
.EQU ALARM_HOUR_D = 0X0218
.DEF ALTERNADOR_LEDS = R23
.DEF ALTERNADOR_DISPLAYS = R24
.ORG 0x0000
	JMP MAIN

.ORG 0X0008
	JMP ISR_PCINT1

.ORG 0X0012
	JMP ISR_TIMER2_OVF

.ORG 0X0020
	JMP ISR_TIMER0_OVF

MAIN:
	LDI R16, LOW(RAMEND)
	OUT SPL, R16
	LDI R17, HIGH(RAMEND)
	OUT SPH, R17

SETUP:
	LDI R16, (1 << CLKPCE)
	STS CLKPR, R16
	
	LDI R16, 0b0000_0010 ; Oscilador a 4MHz
	STS CLKPR, R16

	LDI R16, 0b0011_1111
	OUT DDRB, R16

	LDI R16, 0b1111_1100
	OUT DDRD, R16

	LDI R16, 0b0011_1110
	OUT PORTB, R16

	LDI R16, 0b0010_0001
	OUT DDRC, R16

	LDI R16, (1 << PCINT9)|(1 << PCINT10)|(1 << PCINT11)|(1 << PCINT12)
	STS PCMSK1, R16

	LDI R16, (1 << PCIE1)
	STS PCICR, R16

	CALL INITIALIZE_TIMER0

	LDI R16, (1 << TOIE0)
	STS TIMSK0, R16

	CALL INITIALIZE_TIMER2

	LDI R16, (1 << TOIE2)
	STS TIMSK2, R16

	CALL INITIALIZE_TIME

	SEI

LOOP:
	SBRC CONFIGURE, 0
	JMP MODO_CONFIGURACION
	SBRC BANDERA_ALARMA_BOTONES_SEGUNDO, 0
	RJMP HA_PASADO_SEGUNDO
	JMP IGNORAR_SUMA_SEGUNDO

//########################################################################
//						AUMENTAR TIEMPO
//########################################################################

HA_PASADO_SEGUNDO:
	ANDI BANDERA_ALARMA_BOTONES_SEGUNDO, 0B1111_1110
	LDS R17, SECONDS
	INC R17
	CPI R17, 60 // AQUI
	BREQ HA_PASADO_MINUTO
	JMP NO_HA_PASADO_MINUTO
HA_PASADO_MINUTO:
	CLR R17
	STS SECONDS, R17
	LDS R17, MINUTE
	LDS R16, MINUTE_U
	INC R16
	INC R17
	CPI R16, 10 // AQUI
	BREQ HA_PASADO_10_MINUTO
	JMP NO_HA_PASADO_10_MINUTO
HA_PASADO_10_MINUTO:
	CLR R16
	STS MINUTE_U, R16
	LDS R16, MINUTE_D
	INC R16
	CPI R16, 6 // AQUI
	BREQ HA_PASADO_HORA
	JMP NO_HA_PASADO_HORA
HA_PASADO_HORA:
	CLR R17
	STS MINUTE, R17
	CLR R16
	STS MINUTE_D, R16
	LDS R17, HOUR
	LDS R16, HOUR_U
	INC R17
	INC R16
	CPI R17, 24 // AQUI
	BREQ HA_PASADO_DIA
	JMP NO_HA_PASADO_DIA
HA_PASADO_DIA:
	CLR R16
	STS HOUR_U, R16
	CLR R17
	STS HOUR, R17
	LDS R16, HOUR_D
	CLR R16
	STS HOUR_D, R16
	LDS R17, DAY
	INC R17
	LDS R16, MONTH
	CPI R16, 1 // AQUI
	BREQ ES_MES_REGULAR
	CPI R16, 2 // AQUI
	BREQ ES_FEBRERO
	CPI R16, 3 // AQUI
	BREQ ES_MES_REGULAR
	CPI R16, 4 // AQUI
	BREQ ES_MES_IRREGULAR
	CPI R16, 5 // AQUI
	BREQ ES_MES_REGULAR
	CPI R16, 6 // AQUI
	BREQ ES_MES_IRREGULAR
	CPI R16, 7 // AQUI
	BREQ ES_MES_REGULAR
	CPI R16, 8 // AQUI
	BREQ ES_MES_REGULAR
	CPI R16, 9 // AQUI
	BREQ ES_MES_IRREGULAR
	CPI R16, 10 // AQUI
	BREQ ES_MES_REGULAR
	CPI R16, 11 // AQUI
	BREQ ES_MES_IRREGULAR
	CPI R16, 12 // AQUI
	BREQ ES_MES_REGULAR
ES_FEBRERO:
	STS DAY, R17
	LDS R17, BISIESTO
	CPI R17, 0 // AQUI NO ES NECESARIO
	BRNE NO_ES_BISIESTO
ES_BISIESTO:
	LDS R17, DAY
	CPI R17, 30 // AQUI
	BREQ HA_PASADO_MES
	JMP NO_HA_PASADO_MES
NO_ES_BISIESTO:
	LDS R17, DAY
	CPI R17, 29 // AQUI
	BREQ HA_PASADO_MES
	JMP NO_HA_PASADO_MES
ES_MES_IRREGULAR:
	CPI R17, 31 // AQUI
	BREQ HA_PASADO_MES
	JMP NO_HA_PASADO_MES
ES_MES_REGULAR:
	CPI R17, 32 // AQUI
	BREQ HA_PASADO_MES
	JMP NO_HA_PASADO_MES
HA_PASADO_MES:
	// EN R17 ESTA DAY
	LDI R16, 1
	STS DAY_U, R16
	CLR R16
	STS DAY_D, R16
	LDI R17, 1
	STS DAY, R17
	LDS R17, MONTH
	INC R17
	CPI R17, 13 // AQUI
	BREQ HA_PASADO_YEAR
	JMP NO_HA_PASADO_YEAR
HA_PASADO_YEAR:
	LDI R17, 1
	STS MONTH, R17
	LDI R16, 1
	STS MONTH_U, R16
	CLR R16
	STS MONTH_D, R16
	LDS R17, BISIESTO
	INC R17
	CPI R17, 4 // AQUI NO ES NECESARIO
	BRNE NO_CAMBIAR_BISIESTO
CAMBIAR_BISIESTO:
	CLR R17
NO_CAMBIAR_BISIESTO:
	STS BISIESTO, R17
	LDS R17, YEAR_LOW
	LDS R16, YEAR_U
	INC R17
	INC R16
	CPI R16, 10 // AQUI
	BREQ HA_PASADO_10_YEAR
	JMP NO_HA_PASADO_10_YEAR
HA_PASADO_10_YEAR:
	CLR R16
	STS YEAR_U, R16
	LDS R16, YEAR_D
	INC R16
	CPI R16, 10 // AQUI
	BREQ HA_PASADO_100_YEAR
	JMP NO_HA_PASADO_100_YEAR
HA_PASADO_100_YEAR:
	CLR R16
	STS YEAR_D, R16
	CLR R17
	STS YEAR_LOW, R17
	LDS R17, YEAR_HIGH
	INC R17
	LDS R16, YEAR_C
	INC R16
	CPI R16, 10 // AQUI NO ES NECESARIO
	BRNE NO_HA_PASADO_1000_YEAR
HA_PASADO_1000_YEAR:
	CLR R16
	STS YEAR_C, R16
	LDS R16, YEAR_M
	INC R16
	CPI R16, 10 // AQUI NO ES NECESARIO
	BRNE NO_HA_PASADO_10000_YEAR
HA_PASADO_10000_YEAR:
	CLR R16
	STS YEAR_M, R16
	CLR R17
	STS YEAR_HIGH, R17
	STS BISIESTO, R17
	JMP IGNORAR_SUMA_SEGUNDO
NO_HA_PASADO_10000_YEAR:
	STS YEAR_M, R16
	STS YEAR_HIGH, R17
	JMP IGNORAR_SUMA_SEGUNDO
NO_HA_PASADO_1000_YEAR:
	STS YEAR_C, R16
	STS YEAR_HIGH, R17
	JMP IGNORAR_SUMA_SEGUNDO
NO_HA_PASADO_100_YEAR:
	STS YEAR_D, R16
	STS YEAR_LOW, R17
	JMP IGNORAR_SUMA_SEGUNDO
NO_HA_PASADO_10_YEAR:
	STS YEAR_U, R16
	STS YEAR_LOW, R17
	JMP IGNORAR_SUMA_SEGUNDO
NO_HA_PASADO_YEAR:
	LDS R16, MONTH_U
	INC R16
	CPI R16, 10 // AQUI NO ES NECESARIO
	BRNE NO_HA_PASADO_10_MES
HA_PASADO_10_MES:
	CLR R16
	STS MONTH_U, R16
	LDS R16, MONTH_D
	INC R16
	STS MONTH, R17
	STS MONTH_D, R16
	JMP IGNORAR_SUMA_SEGUNDO
NO_HA_PASADO_10_MES:
	STS MONTH_U, R16
	STS MONTH, R17
	JMP IGNORAR_SUMA_SEGUNDO
NO_HA_PASADO_MES:
	LDS R16, DAY_U
	INC R16
	CPI R16, 10 // AQUI NO ES NECESARIO
	BRNE NO_HA_PASADO_10_DIA
HA_PASADO_10_DIA:
	CLR R16
	STS DAY_U, R16
	LDS R16, DAY_D
	INC R16
	STS DAY, R17
	STS DAY_D, R16
	RJMP IGNORAR_SUMA_SEGUNDO
NO_HA_PASADO_10_DIA:
	STS DAY, R17
	STS DAY_U, R16
	RJMP IGNORAR_SUMA_SEGUNDO
NO_HA_PASADO_DIA:
	CPI R16, 10 // AQUI NO ES NECESARIO
	BRNE NO_HA_PASADO_10_HORA
HA_PASADO_10_HORA:
	CLR R16
	STS HOUR_U, R16
	LDS R16, HOUR_D
	INC R16
	STS HOUR, R17
	STS HOUR_D, R16
	RJMP IGNORAR_SUMA_SEGUNDO
NO_HA_PASADO_10_HORA:
	STS HOUR, R17
	STS HOUR_U, R16
	RJMP IGNORAR_SUMA_SEGUNDO
NO_HA_PASADO_HORA:
	STS MINUTE, R17
	STS MINUTE_D, R16
	RJMP IGNORAR_SUMA_SEGUNDO
NO_HA_PASADO_10_MINUTO:
	STS MINUTE, R17
	STS MINUTE_U, R16
	RJMP IGNORAR_SUMA_SEGUNDO
NO_HA_PASADO_MINUTO:
	STS SECONDS, R17
IGNORAR_SUMA_SEGUNDO:
	JMP VERIFICAR_ALARMA

//########################################################################
//						VERIFICAR ALARMA
//########################################################################

VERIFICAR_ALARMA:
	SBRC BANDERA_ALARMA_BOTONES_SEGUNDO, 3
	JMP COMPARAR_HORAS
	JMP MUESTREO_DISPLAYS
COMPARAR_HORAS:
	LDS R16, ALARM_HOUR
	LDS R17, HOUR
	CP R16, R17
	BREQ COMPARAR_MINUTOS
	JMP MUESTREO_DISPLAYS
COMPARAR_MINUTOS:
	LDS R16, ALARM_MINUTE
	LDS R17, MINUTE
	CP R16, R17
	BREQ ACTIVAR_ALARMA
	JMP MUESTREO_DISPLAYS
ACTIVAR_ALARMA:
	SBRC BANDERA_ALARMA_BOTONES_SEGUNDO, 3
	ORI BANDERA_ALARMA_BOTONES_SEGUNDO, 0B0001_0000
	JMP MUESTREO_DISPLAYS

//########################################################################
//						MODO CONFIGURACION
//########################################################################

MODO_CONFIGURACION:
	SBRC MODE, 0
	JMP CONFIG_HORA_MIN
	SBRC MODE, 1
	JMP CONFIG_FECHA
	SBRC MODE, 2
	JMP CONFIG_YEAR
	SBRC MODE, 3
	JMP CONFIG_ALARMA
//########################################################################
//						CONFIGURACION DE HORA Y MINUTOS
//########################################################################
CONFIG_HORA_MIN:
	CLR R17
	STS SECONDS, R17
	SBRC CONFIGURE, 1
	JMP CONFIG_MIN
CONFIG_HORA:
	SBRC BANDERA_ALARMA_BOTONES_SEGUNDO, 1
	JMP INCREMENTAR_HORA
	SBRC BANDERA_ALARMA_BOTONES_SEGUNDO, 2
	JMP DECREMENTAR_HORA
	JMP MUESTREO_DISPLAYS
INCREMENTAR_HORA:
	ANDI BANDERA_ALARMA_BOTONES_SEGUNDO, 0B1111_1101
	LDS R17, HOUR
	LDS R16, HOUR_U
	INC R17
	CPI R17, 24
	BREQ HORA_DE_24_A_0
	JMP HORA_NO_DE_24_A_0
HORA_DE_24_A_0:
	CLR R16
	STS HOUR_U, R16
	STS HOUR_D, R16
	CLR R17
	STS HOUR, R17
	JMP MUESTREO_DISPLAYS
HORA_NO_DE_24_A_0:
	INC R16
	CPI R16, 10
	BREQ AUMENTO_DECENA_HORA
	JMP NO_AUMENTO_DECENA_HORA
AUMENTO_DECENA_HORA:
	CLR R16
	STS HOUR_U, R16
	LDS R16, HOUR_D
	INC R16
	STS HOUR_D, R16
	STS HOUR, R17
	JMP MUESTREO_DISPLAYS
NO_AUMENTO_DECENA_HORA:
	STS HOUR_U, R16
	STS HOUR, R17
	JMP MUESTREO_DISPLAYS
DECREMENTAR_HORA:
	ANDI BANDERA_ALARMA_BOTONES_SEGUNDO, 0B1111_1011
	LDS R17, HOUR
	LDS R16, HOUR_U
	DEC R17
	CPI R17, -1
	BREQ HORA_DE_0_A_23
	JMP HORA_NO_DE_0_A_23
HORA_DE_0_A_23:
	LDI R16, 3
	STS HOUR_U, R16
	LDI R16, 2
	STS HOUR_D, R16
	LDI R17, 23
	STS HOUR, R17
	JMP MUESTREO_DISPLAYS
HORA_NO_DE_0_A_23:
	DEC R16
	CPI R16, -1
	BREQ REDUCCION_DECENA_HORA
	JMP NO_REDUCCION_DECENA_HORA
REDUCCION_DECENA_HORA:
	LDI R16, 9
	STS HOUR_U, R16
	LDS R16, HOUR_D
	DEC R16
	STS HOUR_D, R16
	STS HOUR, R17
	JMP MUESTREO_DISPLAYS
NO_REDUCCION_DECENA_HORA:
	STS HOUR_U, R16
	STS HOUR, R17
	JMP MUESTREO_DISPLAYS
CONFIG_MIN:
	SBRC BANDERA_ALARMA_BOTONES_SEGUNDO, 1
	JMP INCREMENTAR_MIN
	SBRC BANDERA_ALARMA_BOTONES_SEGUNDO, 2
	JMP DECREMENTAR_MIN
	JMP MUESTREO_DISPLAYS
INCREMENTAR_MIN:
	ANDI BANDERA_ALARMA_BOTONES_SEGUNDO, 0B1111_1101
	LDS R17, MINUTE
	LDS R16, MINUTE_U
	INC R17
	CPI R17, 60
	BREQ MIN_DE_60_A_0
	JMP MIN_NO_DE_60_A_0
MIN_DE_60_A_0:
	CLR R16
	STS MINUTE_U, R16
	STS MINUTE_D, R16
	CLR R17
	STS MINUTE, R17
	JMP MUESTREO_DISPLAYS
MIN_NO_DE_60_A_0:
	INC R16
	CPI R16, 10
	BREQ AUMENTO_DECENA_MIN
	JMP NO_AUMENTO_DECENA_MIN
AUMENTO_DECENA_MIN:
	CLR R16
	STS MINUTE_U, R16
	LDS R16, MINUTE_D
	INC R16
	STS MINUTE_D, R16
	STS MINUTE, R17
	JMP MUESTREO_DISPLAYS
NO_AUMENTO_DECENA_MIN:
	STS MINUTE_U, R16
	STS MINUTE, R17
	JMP MUESTREO_DISPLAYS
DECREMENTAR_MIN:
	ANDI BANDERA_ALARMA_BOTONES_SEGUNDO, 0B1111_1011
	LDS R17, MINUTE
	LDS R16, MINUTE_U
	DEC R17
	CPI R17, -1
	BREQ MIN_DE_0_A_60
	JMP MIN_NO_DE_0_A_60
MIN_DE_0_A_60:
	LDI R16, 9
	STS MINUTE_U, R16
	LDI R16, 5
	STS MINUTE_D, R16
	LDI R17, 59
	STS MINUTE, R17
	JMP MUESTREO_DISPLAYS
MIN_NO_DE_0_A_60:
	DEC R16
	CPI R16, -1
	BREQ REDUCCION_DECENA_MIN
	JMP NO_REDUCCION_DECENA_MIN
REDUCCION_DECENA_MIN:
	LDI R16, 9
	STS MINUTE_U, R16
	LDS R16, MINUTE_D
	DEC R16
	STS MINUTE_D, R16
	STS MINUTE, R17
	JMP MUESTREO_DISPLAYS
NO_REDUCCION_DECENA_MIN:
	STS MINUTE_U, R16
	STS MINUTE, R17
	JMP MUESTREO_DISPLAYS
//########################################################################
//						CONFIGURACION DE FECHA
//########################################################################
CONFIG_FECHA:
	SBRC CONFIGURE, 1
	JMP CONFIG_MES
CONFIG_DIA:
	SBRC BANDERA_ALARMA_BOTONES_SEGUNDO, 1
	JMP INCREMENTAR_DIA
	SBRC BANDERA_ALARMA_BOTONES_SEGUNDO, 2
	JMP DECREMENTAR_DIA
	JMP MUESTREO_DISPLAYS
INCREMENTAR_DIA:
	ANDI BANDERA_ALARMA_BOTONES_SEGUNDO, 0B1111_1101
	LDS R17, DAY
	LDS R16, MONTH
	INC R17
	CPI R16, 1
	BREQ AUMENTO_EN_MES_REGULAR
	CPI R16, 2
	BREQ AUMENTO_EN_FEBRERO
	CPI R16, 3
	BREQ AUMENTO_EN_MES_REGULAR
	CPI R16, 4
	BREQ AUMENTO_EN_MES_IRREGULAR
	CPI R16, 5
	BREQ AUMENTO_EN_MES_REGULAR
	CPI R16, 6
	BREQ AUMENTO_EN_MES_IRREGULAR
	CPI R16, 7
	BREQ AUMENTO_EN_MES_REGULAR
	CPI R16, 8
	BREQ AUMENTO_EN_MES_REGULAR
	CPI R16, 9
	BREQ AUMENTO_EN_MES_IRREGULAR
	CPI R16, 10
	BREQ AUMENTO_EN_MES_REGULAR
	CPI R16, 11
	BREQ AUMENTO_EN_MES_IRREGULAR
	CPI R16, 12
	BREQ AUMENTO_EN_MES_REGULAR
AUMENTO_EN_MES_REGULAR:
	CPI R17, 32
	BREQ AUMENTO_DIA_A_1
	RJMP AUMENTO_DIA_NORMAL
AUMENTO_EN_FEBRERO:
	LDS R16, BISIESTO
	CPI R16, 0
	BREQ AUMENTO_EN_BISIESTO
	RJMP AUMENTO_NO_EN_BISIESTO
AUMENTO_EN_BISIESTO:
	CPI R17, 30
	BREQ AUMENTO_DIA_A_1
	RJMP AUMENTO_DIA_NORMAL
AUMENTO_NO_EN_BISIESTO:
	CPI R17, 29
	BREQ AUMENTO_DIA_A_1
	RJMP AUMENTO_DIA_NORMAL
AUMENTO_EN_MES_IRREGULAR:
	CPI R17, 31
	BREQ AUMENTO_DIA_A_1
	RJMP AUMENTO_DIA_NORMAL
AUMENTO_DIA_A_1:
	LDI R17, 1
	STS DAY_U, R17
	STS DAY, R17
	CLR R17
	STS DAY_D, R17
	JMP MUESTREO_DISPLAYS
AUMENTO_DIA_NORMAL:
	LDS R16, DAY_U
	INC R16
	CPI R16, 10
	BREQ AUMENTO_DIA_DECENA
	JMP NO_AUMENTO_DIA_DECENA
AUMENTO_DIA_DECENA:
	CLR R16
	STS DAY_U, R16
	LDS R16, DAY_D
	INC R16
	STS DAY_D, R16
	STS DAY, R17
	JMP MUESTREO_DISPLAYS
NO_AUMENTO_DIA_DECENA:
	STS DAY_U, R16
	STS DAY, R17
	JMP MUESTREO_DISPLAYS
DECREMENTAR_DIA:
	ANDI BANDERA_ALARMA_BOTONES_SEGUNDO, 0B1111_1011
	LDS R17, DAY
	LDS R16, MONTH
	DEC R17
	CPI R17, 0
	BREQ REDUCCION_DIA_A_TOPE
	JMP REDUCCION_NORMAL
REDUCCION_DIA_A_TOPE:
	CPI R16, 1
	BREQ REDUCCION_EN_MES_REGULAR
	CPI R16, 2
	BREQ REDUCCION_EN_FEBRERO
	CPI R16, 3
	BREQ REDUCCION_EN_MES_REGULAR
	CPI R16, 4
	BREQ REDUCCION_EN_MES_IRREGULAR
	CPI R16, 5
	BREQ REDUCCION_EN_MES_REGULAR
	CPI R16, 6
	BREQ REDUCCION_EN_MES_IRREGULAR
	CPI R16, 7
	BREQ REDUCCION_EN_MES_REGULAR
	CPI R16, 8
	BREQ REDUCCION_EN_MES_REGULAR
	CPI R16, 9
	BREQ REDUCCION_EN_MES_IRREGULAR
	CPI R16, 10
	BREQ REDUCCION_EN_MES_REGULAR
	CPI R16, 11
	BREQ REDUCCION_EN_MES_IRREGULAR
	CPI R16, 12
	BREQ REDUCCION_EN_MES_REGULAR
REDUCCION_EN_MES_REGULAR:
	LDI R17, 1
	STS DAY_U, R17
	LDI R17, 3
	STS DAY_D, R17
	LDI R17, 31
	STS DAY, R17
	JMP MUESTREO_DISPLAYS
REDUCCION_EN_FEBRERO:
	LDS R16, BISIESTO
	CPI R16, 0
	BREQ REDUCCION_EN_BISIESTO
	JMP REDUCCION_NO_EN_BISIESTO
REDUCCION_EN_BISIESTO:
	LDI R17, 9
	STS DAY_U, R17
	LDI R17, 2
	STS DAY_D, R17
	LDI R17, 29
	STS DAY, R17
	JMP MUESTREO_DISPLAYS
REDUCCION_NO_EN_BISIESTO:
	LDI R17, 8
	STS DAY_U, R17
	LDI R17, 2
	STS DAY_D, R17
	LDI R17, 28
	STS DAY, R17
	JMP MUESTREO_DISPLAYS
REDUCCION_EN_MES_IRREGULAR:
	LDI R17, 0
	STS DAY_U, R17
	LDI R17, 3
	STS DAY_D, R17
	LDI R17, 30
	STS DAY, R17
	JMP MUESTREO_DISPLAYS
REDUCCION_NORMAL:
	LDS R16, DAY_U
	DEC R16
	CPI R16, -1
	BREQ REDUCCION_DECENAS_DIA
	JMP NO_REDUCCION_DECENAS_DIA
REDUCCION_DECENAS_DIA:
	LDI R16, 9
	STS DAY_U, R16
	LDS R16, DAY_D
	DEC R16
	STS DAY_D, R16
	STS DAY, R17
	JMP MUESTREO_DISPLAYS
NO_REDUCCION_DECENAS_DIA:
	STS DAY_U, R16
	STS DAY, R17
	JMP MUESTREO_DISPLAYS
CONFIG_MES:
	SBRC BANDERA_ALARMA_BOTONES_SEGUNDO, 1
	JMP INCREMENTAR_MES
	SBRC BANDERA_ALARMA_BOTONES_SEGUNDO, 2
	JMP DECREMENTAR_MES
	JMP MUESTREO_DISPLAYS
INCREMENTAR_MES:
	ANDI BANDERA_ALARMA_BOTONES_SEGUNDO, 0B1111_1101
	LDS R17, MONTH
	LDS R16, MONTH_U
	INC R17
	CPI R17, 13
	BREQ AUMENTO_MES_A_1
	JMP AUMENTO_MES_NORMAL
AUMENTO_MES_A_1:
	LDI R17, 1
	STS MONTH, R17
	STS MONTH_U, R17
	CLR R17
	STS MONTH_D, R17
	JMP HUBO_CAMBIO_EN_MES
AUMENTO_MES_NORMAL:
	INC R16
	CPI R16, 10
	BREQ AUMENTO_DECENA_MES
	JMP NO_AUMENTO_DECENA_MES
AUMENTO_DECENA_MES:
	CLR R16
	STS MONTH_U, R16
	LDS R16, MONTH_D
	INC R16
	STS MONTH_D, R16
	STS MONTH, R17
	JMP HUBO_CAMBIO_EN_MES
NO_AUMENTO_DECENA_MES:
	STS MONTH_U, R16
	STS MONTH, R17
	JMP HUBO_CAMBIO_EN_MES
DECREMENTAR_MES:
	ANDI BANDERA_ALARMA_BOTONES_SEGUNDO, 0B1111_1011
	LDS R17, MONTH
	LDS R16, MONTH_U
	DEC R17
	CPI R17, 0
	BREQ REDUCCION_MES_A_12
	JMP REDUCCION_MES_NORMAL
REDUCCION_MES_A_12:
	LDI R17, 2
	STS MONTH_U, R17
	LDI R17, 1
	STS MONTH_D, R17
	LDI R17, 12
	STS MONTH, R17
	JMP HUBO_CAMBIO_EN_MES
REDUCCION_MES_NORMAL:
	DEC R16
	CPI R16, -1
	BREQ REDUCCION_MES_DECENA
	JMP NO_REDUCCION_MES_DECENA
REDUCCION_MES_DECENA:
	LDI R16, 9
	STS MONTH_U, R16
	LDS R16, MONTH_D
	DEC R16
	STS MONTH_D, R16
	STS MONTH, R17
	JMP HUBO_CAMBIO_EN_MES
NO_REDUCCION_MES_DECENA:
	STS MONTH_U, R16
	STS MONTH, R17
	JMP HUBO_CAMBIO_EN_MES
HUBO_CAMBIO_EN_MES:
	LDS R17, DAY
	LDS R16, MONTH
	CPI R16, 1
	BREQ CAMBIO_A_MES_REGULAR
	CPI R16, 2
	BREQ CAMBIO_A_FEBRERO
	CPI R16, 3
	BREQ CAMBIO_A_MES_REGULAR
	CPI R16, 4
	BREQ CAMBIO_A_MES_IRREGULAR
	CPI R16, 5
	BREQ CAMBIO_A_MES_REGULAR
	CPI R16, 6
	BREQ CAMBIO_A_MES_IRREGULAR
	CPI R16, 7
	BREQ CAMBIO_A_MES_REGULAR
	CPI R16, 8
	BREQ CAMBIO_A_MES_REGULAR
	CPI R16, 9
	BREQ CAMBIO_A_MES_IRREGULAR
	CPI R16, 10
	BREQ CAMBIO_A_MES_REGULAR
	CPI R16, 11
	BREQ CAMBIO_A_MES_IRREGULAR
	CPI R16, 12
	BREQ CAMBIO_A_MES_REGULAR
CAMBIO_A_MES_REGULAR:
	LDI R16, 31
	CP R16, R17
	BRSH NO_MODIFICAR_MES
	STS DAY, R16
	LDI R16, 1
	STS DAY_U, R16
	LDI R16, 3
	STS DAY_D, R16
	JMP MUESTREO_DISPLAYS
CAMBIO_A_FEBRERO:
	LDS R16, BISIESTO
	CPI R16, 0
	BREQ CAMBIO_A_FEBRERO_BISIESTO
CAMBIO_A_FEBRERO_NO_BISIESTO:
	LDI R16, 28
	CP R16, R17
	BRSH NO_MODIFICAR_MES
	STS DAY, R16
	LDI R16, 8
	STS DAY_U, R16
	LDI R16, 2
	STS DAY_D, R16
	JMP MUESTREO_DISPLAYS
CAMBIO_A_FEBRERO_BISIESTO:
	LDI R16, 29
	CP R16, R17
	BRSH NO_MODIFICAR_MES
	STS DAY, R16
	LDI R16, 9
	STS DAY_U, R16
	LDI R16, 2
	STS DAY_D, R16
	JMP MUESTREO_DISPLAYS
CAMBIO_A_MES_IRREGULAR:
	LDI R16, 30
	CP R16, R17
	BRSH NO_MODIFICAR_MES
	STS DAY, R16
	LDI R16, 0
	STS DAY_U, R16
	LDI R16, 3
	STS DAY_D, R16
	JMP MUESTREO_DISPLAYS
NO_MODIFICAR_MES:
	JMP MUESTREO_DISPLAYS
//########################################################################
//						CONFIGURACION DE AÑO
//########################################################################
CONFIG_YEAR:
	SBRC BANDERA_ALARMA_BOTONES_SEGUNDO, 1
	JMP INCREMENTAR_YEAR
	SBRC BANDERA_ALARMA_BOTONES_SEGUNDO, 2
	JMP DECREMENTAR_YEAR
	JMP MUESTREO_DISPLAYS
INCREMENTAR_YEAR:
	ANDI BANDERA_ALARMA_BOTONES_SEGUNDO, 0B1111_1101
	LDS R17, BISIESTO
	INC R17
	CPI R17, 4
	BRNE NO_REINICIA_BISIESTO
	CLR R17
NO_REINICIA_BISIESTO:
	STS BISIESTO, R17
	LDS R17, YEAR_LOW
	LDS R16, YEAR_U
	INC R17
	INC R16
	CPI R16, 10
	BREQ AUMENTO_YEAR_DECENA
	JMP NO_AUMENTO_YEAR_DECENA
AUMENTO_YEAR_DECENA:
	CLR R16
	STS YEAR_U, R16
	LDS R16, YEAR_D
	INC R16
	CPI R16, 10
	BREQ AUMENTO_YEAR_CENTENA
	JMP NO_AUMENTO_YEAR_CENTENA
AUMENTO_YEAR_CENTENA:
	CLR R16
	CLR R17
	STS YEAR_D, R16
	STS YEAR_LOW, R17
	LDS R16, YEAR_C
	LDS R17, YEAR_HIGH
	INC R16
	INC R17
	CPI R16, 10
	BREQ AUMENTO_YEAR_MILLAR
	JMP NO_AUMENTO_YEAR_MILLAR
AUMENTO_YEAR_MILLAR:
	CLR R16
	STS YEAR_C, R16
	LDS R16, YEAR_M
	INC R16
	CPI R16, 10
	BREQ REINICIO_YEAR
	JMP NO_REINICIO_YEAR
REINICIO_YEAR:
	CLR R16
	STS YEAR_M, R16
	STS YEAR_HIGH, R16
	STS BISIESTO, R16
	JMP MUESTREO_DISPLAYS
NO_REINICIO_YEAR:
	STS YEAR_M, R16
	STS YEAR_HIGH, R17
	JMP MUESTREO_DISPLAYS
NO_AUMENTO_YEAR_MILLAR:
	STS YEAR_C, R16
	STS YEAR_HIGH, R17
	JMP MUESTREO_DISPLAYS
NO_AUMENTO_YEAR_CENTENA:
	STS YEAR_LOW, R17
	STS YEAR_D, R16
	JMP MUESTREO_DISPLAYS
NO_AUMENTO_YEAR_DECENA:
	STS YEAR_LOW, R17
	STS YEAR_U, R16
	JMP MUESTREO_DISPLAYS
DECREMENTAR_YEAR:
	ANDI BANDERA_ALARMA_BOTONES_SEGUNDO, 0B1111_1011
	LDS R17, BISIESTO
	DEC R17
	CPI R17, -1
	BRNE BISIESTO_NO_A_3
	LDI R17, 3
BISIESTO_NO_A_3:
	STS BISIESTO, R17
	LDS R17, YEAR_LOW
	LDS R16, YEAR_U
	DEC R17
	DEC R16
	CPI R16, -1
	BREQ REDUCCION_YEAR_DECENA
	JMP NO_REDUCCION_YEAR_DECENA
REDUCCION_YEAR_DECENA:
	LDI R16, 9
	STS YEAR_U, R16
	LDS R16, YEAR_D
	DEC R16
	CPI R16, -1
	BREQ REDUCCION_YEAR_CENTENA
	JMP NO_REDUCCION_YEAR_CENTENA
REDUCCION_YEAR_CENTENA:
	LDI R16, 9
	STS YEAR_D, R16
	LDI R17, 99
	STS YEAR_LOW, R17
	LDS R16, YEAR_C
	LDS R17, YEAR_HIGH
	DEC R16
	DEC R17
	CPI R16, -1
	BREQ REDUCCION_YEAR_MILLAR
	JMP NO_REDUCCION_YEAR_MILLAR
REDUCCION_YEAR_MILLAR:
	LDI R16, 9
	STS YEAR_C, R16
	LDS R16, YEAR_M
	DEC R16
	CPI R16, -1
	BREQ REDUCCION_YEAR_A_9999
	JMP NO_REDUCCION_YEAR_A_9999
REDUCCION_YEAR_A_9999:
	LDI R16, 9
	STS YEAR_M, R16
	LDI R17, 99
	STS YEAR_HIGH, R17
	LDI R17, 3
	STS BISIESTO, R17
	JMP MUESTREO_DISPLAYS
NO_REDUCCION_YEAR_A_9999:
	STS YEAR_HIGH, R17
	STS YEAR_M, R16
	JMP MUESTREO_DISPLAYS
NO_REDUCCION_YEAR_MILLAR:
	STS YEAR_HIGH, R17
	STS YEAR_C, R16
	JMP MUESTREO_DISPLAYS
NO_REDUCCION_YEAR_CENTENA:
	STS YEAR_LOW, R17
	STS YEAR_D, R16
	JMP MUESTREO_DISPLAYS
NO_REDUCCION_YEAR_DECENA:
	STS YEAR_LOW, R17
	STS YEAR_U, R16
	JMP MUESTREO_DISPLAYS
//########################################################################
//						CONFIGURACION DE ALARMA
//########################################################################
CONFIG_ALARMA:
	SBRC CONFIGURE, 1
	JMP CONFIG_ALARMA_MIN
CONFIG_ALARMA_HORA:
	SBRC BANDERA_ALARMA_BOTONES_SEGUNDO, 1
	JMP INCREMENTAR_ALARMA_HORA
	SBRC BANDERA_ALARMA_BOTONES_SEGUNDO, 2
	JMP DECREMENTAR_ALARMA_HORA
	JMP MUESTREO_DISPLAYS
INCREMENTAR_ALARMA_HORA:
	ANDI BANDERA_ALARMA_BOTONES_SEGUNDO, 0B1111_1101
	LDS R17, ALARM_HOUR
	LDS R16, ALARM_HOUR_U
	INC R17
	CPI R17, 24
	BREQ ALARMA_HORA_DE_24_A_0
	JMP ALARMA_HORA_NO_DE_24_A_0
ALARMA_HORA_DE_24_A_0:
	CLR R16
	STS ALARM_HOUR_U, R16
	STS ALARM_HOUR_D, R16
	CLR R17
	STS ALARM_HOUR, R17
	JMP MUESTREO_DISPLAYS
ALARMA_HORA_NO_DE_24_A_0:
	INC R16
	CPI R16, 10
	BREQ AUMENTO_DECENA_ALARMA_HORA
	JMP NO_AUMENTO_DECENA_ALARMA_HORA
AUMENTO_DECENA_ALARMA_HORA:
	CLR R16
	STS ALARM_HOUR_U, R16
	LDS R16, ALARM_HOUR_D
	INC R16
	STS ALARM_HOUR_D, R16
	STS ALARM_HOUR, R17
	JMP MUESTREO_DISPLAYS
NO_AUMENTO_DECENA_ALARMA_HORA:
	STS ALARM_HOUR_U, R16
	STS ALARM_HOUR, R17
	JMP MUESTREO_DISPLAYS
DECREMENTAR_ALARMA_HORA:
	ANDI BANDERA_ALARMA_BOTONES_SEGUNDO, 0B1111_1011
	LDS R17, ALARM_HOUR
	LDS R16, ALARM_HOUR_U
	DEC R17
	CPI R17, -1
	BREQ ALARMA_HORA_DE_0_A_23
	JMP ALARMA_HORA_NO_DE_0_A_23
ALARMA_HORA_DE_0_A_23:
	LDI R16, 3
	STS ALARM_HOUR_U, R16
	LDI R16, 2
	STS ALARM_HOUR_D, R16
	LDI R17, 23
	STS ALARM_HOUR, R17
	JMP MUESTREO_DISPLAYS
ALARMA_HORA_NO_DE_0_A_23:
	DEC R16
	CPI R16, -1
	BREQ REDUCCION_DECENA_ALARMA_HORA
	JMP NO_REDUCCION_DECENA_ALARMA_HORA
REDUCCION_DECENA_ALARMA_HORA:
	LDI R16, 9
	STS ALARM_HOUR_U, R16
	LDS R16, ALARM_HOUR_D
	DEC R16
	STS ALARM_HOUR_D, R16
	STS ALARM_HOUR, R17
	JMP MUESTREO_DISPLAYS
NO_REDUCCION_DECENA_ALARMA_HORA:
	STS ALARM_HOUR_U, R16
	STS ALARM_HOUR, R17
	JMP MUESTREO_DISPLAYS
CONFIG_ALARMA_MIN:
	SBRC BANDERA_ALARMA_BOTONES_SEGUNDO, 1
	JMP INCREMENTAR_ALARMA_MIN
	SBRC BANDERA_ALARMA_BOTONES_SEGUNDO, 2
	JMP DECREMENTAR_ALARMA_MIN
	JMP MUESTREO_DISPLAYS
INCREMENTAR_ALARMA_MIN:
	ANDI BANDERA_ALARMA_BOTONES_SEGUNDO, 0B1111_1101
	LDS R17, ALARM_MINUTE
	LDS R16, ALARM_MINUTE_U
	INC R17
	CPI R17, 60
	BREQ ALARMA_MIN_DE_60_A_0
	JMP ALARMA_MIN_NO_DE_60_A_0
ALARMA_MIN_DE_60_A_0:
	CLR R16
	STS ALARM_MINUTE_U, R16
	STS ALARM_MINUTE_D, R16
	CLR R17
	STS ALARM_MINUTE, R17
	JMP MUESTREO_DISPLAYS
ALARMA_MIN_NO_DE_60_A_0:
	INC R16
	CPI R16, 10
	BREQ AUMENTO_DECENA_ALARMA_MIN
	JMP NO_AUMENTO_DECENA_ALARMA_MIN
AUMENTO_DECENA_ALARMA_MIN:
	CLR R16
	STS ALARM_MINUTE_U, R16
	LDS R16, ALARM_MINUTE_D
	INC R16
	STS ALARM_MINUTE_D, R16
	STS ALARM_MINUTE, R17
	JMP MUESTREO_DISPLAYS
NO_AUMENTO_DECENA_ALARMA_MIN:
	STS ALARM_MINUTE_U, R16
	STS ALARM_MINUTE, R17
	JMP MUESTREO_DISPLAYS
DECREMENTAR_ALARMA_MIN:
	ANDI BANDERA_ALARMA_BOTONES_SEGUNDO, 0B1111_1011
	LDS R17, ALARM_MINUTE
	LDS R16, ALARM_MINUTE_U
	DEC R17
	CPI R17, -1
	BREQ ALARMA_MIN_DE_0_A_60
	JMP ALARMA_MIN_NO_DE_0_A_60
ALARMA_MIN_DE_0_A_60:
	LDI R16, 9
	STS ALARM_MINUTE_U, R16
	LDI R16, 5
	STS ALARM_MINUTE_D, R16
	LDI R17, 59
	STS ALARM_MINUTE, R17
	JMP MUESTREO_DISPLAYS
ALARMA_MIN_NO_DE_0_A_60:
	DEC R16
	CPI R16, -1
	BREQ REDUCCION_DECENA_ALARMA_MIN
	JMP NO_REDUCCION_DECENA_ALARMA_MIN
REDUCCION_DECENA_ALARMA_MIN:
	LDI R16, 9
	STS ALARM_MINUTE_U, R16
	LDS R16, ALARM_MINUTE_D
	DEC R16
	STS ALARM_MINUTE_D, R16
	STS ALARM_MINUTE, R17
	JMP MUESTREO_DISPLAYS
NO_REDUCCION_DECENA_ALARMA_MIN:
	STS ALARM_MINUTE_U, R16
	STS ALARM_MINUTE, R17
	JMP MUESTREO_DISPLAYS
//########################################################################
//						MUESTREO DE DISPLAYS Y LEDS
//########################################################################
MUESTREO_DISPLAYS:
	SBRC ALTERNADOR_DISPLAYS, 4
	RJMP OTRAS_LEDS
	JMP DIGITOS
OTRAS_LEDS:
	CBI PORTC, PC0			//TRANSISTOR DE OTRAS LEDS
	SBI PORTB, PB5			// DIG 1
	SBI PORTB, PB4			// DIG 2
	SBI PORTB, PB3			// DIG 3
	SBI PORTB, PB2			// DIG 4
	IN R16, PORTD
	IN R17, PORTB
	ORI R16, 0b1111_1100
	ORI R17, 0b0000_0011
	//ANDI R16, 0b0111_0011
	SBRC MODE, 0
	ANDI R16, 0B0111_1111
	SBRC MODE, 1
	ANDI R16, 0B1111_1011
	SBRC MODE, 2
	ANDI R16, 0B1011_1111
	SBRC BANDERA_ALARMA_BOTONES_SEGUNDO, 3
	ANDI R16, 0B1111_0111
	OUT PORTD, R16
	OUT PORTB, R17
	JMP IGNORAR_DISPLAYS
DIGITOS:
	SBRC ALTERNADOR_DISPLAYS, 0
	JMP PRESET_DIGITO1
	SBRC ALTERNADOR_DISPLAYS, 1
	JMP PRESET_DIGITO2
	SBRC ALTERNADOR_DISPLAYS, 2
	JMP PRESET_DIGITO3
	SBRC ALTERNADOR_DISPLAYS, 3
	JMP PRESET_DIGITO4
PRESET_DIGITO1:
	SBI PORTC, PC0			//TRANSISTOR DE OTRAS LEDS
	CBI PORTB, PB5			// DIG 1
	SBI PORTB, PB4			// DIG 2
	SBI PORTB, PB3			// DIG 3
	SBI PORTB, PB2			// DIG 4
	SBRS CONFIGURE, 0
	RJMP ESTABLECER_VALOR_DIGITO1
	SBRC MODE, 2
	RJMP ALTERNAR_VALOR_DIGITO1
	SBRS CONFIGURE, 2
	RJMP ESTABLECER_VALOR_DIGITO1
ALTERNAR_VALOR_DIGITO1:
	SBRC ALTERNADOR_LEDS, 0
	RJMP ESTABLECER_VALOR_DIGITO1
APAGAR_DIGITO1:
	LDI R18, 10
	JMP SHOW_DISPLAYS
ESTABLECER_VALOR_DIGITO1:
	SBRC MODE, 0
	LDS R18, HOUR_D
	SBRC MODE, 1
	LDS R18, DAY_D
	SBRC MODE, 2
	LDS R18, YEAR_M
	SBRC MODE, 3
	LDS R18, ALARM_HOUR_D
	JMP SHOW_DISPLAYS
PRESET_DIGITO2:
	SBI PORTC, PC0			//TRANSISTOR DE OTRAS LEDS
	SBI PORTB, PB5			// DIG 1
	CBI PORTB, PB4			// DIG 2
	SBI PORTB, PB3			// DIG 3
	SBI PORTB, PB2			// DIG 4
	SBRS CONFIGURE, 0
	RJMP ESTABLECER_VALOR_DIGITO2
	SBRC MODE, 2
	RJMP ALTERNAR_VALOR_DIGITO2
	SBRS CONFIGURE, 2
	RJMP ESTABLECER_VALOR_DIGITO2
ALTERNAR_VALOR_DIGITO2:
	SBRC ALTERNADOR_LEDS, 0
	RJMP ESTABLECER_VALOR_DIGITO2
APAGAR_DIGITO2:
	LDI R18, 10
	JMP SHOW_DISPLAYS
ESTABLECER_VALOR_DIGITO2:
	SBRC MODE, 0
	LDS R18, HOUR_U
	SBRC MODE, 1
	LDS R18, DAY_U
	SBRC MODE, 2
	LDS R18, YEAR_C
	SBRC MODE, 3
	LDS R18, ALARM_HOUR_U
	JMP SHOW_DISPLAYS
PRESET_DIGITO3:
	SBI PORTC, PC0			//TRANSISTOR DE OTRAS LEDS
	SBI PORTB, PB5			// DIG 1
	SBI PORTB, PB4			// DIG 2
	CBI PORTB, PB3			// DIG 3
	SBI PORTB, PB2			// DIG 4
	SBRS CONFIGURE, 0
	RJMP ESTABLECER_VALOR_DIGITO3
	SBRC MODE, 2
	RJMP ALTERNAR_VALOR_DIGITO3
	SBRS CONFIGURE, 1
	RJMP ESTABLECER_VALOR_DIGITO3
ALTERNAR_VALOR_DIGITO3:
	SBRC ALTERNADOR_LEDS, 0
	RJMP ESTABLECER_VALOR_DIGITO3
APAGAR_DIGITO3:
	LDI R18, 10
	JMP SHOW_DISPLAYS
ESTABLECER_VALOR_DIGITO3:
	SBRC MODE, 0
	LDS R18, MINUTE_D
	SBRC MODE, 1
	LDS R18, MONTH_D
	SBRC MODE, 2
	LDS R18, YEAR_D
	SBRC MODE, 3
	LDS R18, ALARM_MINUTE_D
	JMP SHOW_DISPLAYS
PRESET_DIGITO4:
	SBI PORTC, PC0			//TRANSISTOR DE OTRAS LEDS
	SBI PORTB, PB5			// DIG 1
	SBI PORTB, PB4			// DIG 2
	SBI PORTB, PB3			// DIG 3
	CBI PORTB, PB2			// DIG 4
	SBRS CONFIGURE, 0
	RJMP ESTABLECER_VALOR_DIGITO4
	SBRC MODE, 2
	RJMP ALTERNAR_VALOR_DIGITO4
	SBRS CONFIGURE, 1
	RJMP ESTABLECER_VALOR_DIGITO4
ALTERNAR_VALOR_DIGITO4:
	SBRC ALTERNADOR_LEDS, 0
	RJMP ESTABLECER_VALOR_DIGITO4
APAGAR_DIGITO4:
	LDI R18, 10
	JMP SHOW_DISPLAYS
ESTABLECER_VALOR_DIGITO4:
	SBRC MODE, 0
	LDS R18, MINUTE_U
	SBRC MODE, 1
	LDS R18, MONTH_U
	SBRC MODE, 2
	LDS R18, YEAR_U
	SBRC MODE, 3
	LDS R18, ALARM_MINUTE_U
	JMP SHOW_DISPLAYS
SHOW_DISPLAYS:
	LDI ZH, HIGH(TABLA << 1)
	LDI ZL, LOW(TABLA << 1)
	ADD ZL, R18
	BRCC NO_CARRY
	INC ZH
NO_CARRY:
	LPM R16, Z
	IN R17, PORTB
	LSL R16
	BRCS CARRY_SET
	ANDI R17, 0b1111_1110
	RJMP CONTINUAR_AFTER_CARRY
CARRY_SET:
	ORI R17, 0b0000_0001
CONTINUAR_AFTER_CARRY:
	SBRC MODE, 2
	RJMP NO_ENCENDER_LEDS_MEDIO
	SBRC CONFIGURE, 0
	RJMP ENCENDER_LEDS_MEDIO
	SBRC MODE, 0
	RJMP ALTERNAR_LEDS_MEDIO
	SBRC MODE, 1
	RJMP ENCENDER_LEDS_MEDIO
	SBRC MODE, 3
	RJMP ENCENDER_LEDS_MEDIO
ALTERNAR_LEDS_MEDIO:
	SBRC ALTERNADOR_LEDS, 0
	RJMP ENCENDER_LEDS_MEDIO
NO_ENCENDER_LEDS_MEDIO:
	ORI R17, 0b0000_0010
	RJMP CONTINUAR_AFTER_LEDS
ENCENDER_LEDS_MEDIO:
	ANDI R17, 0b1111_1101
CONTINUAR_AFTER_LEDS:
	SBRC BANDERA_ALARMA_BOTONES_SEGUNDO, 4
	JMP ALTERNAR_ALARMA
	JMP CALLAR_ALARMA
ALTERNAR_ALARMA:
	SBRS ALTERNADOR_LEDS, 0
	JMP CALLAR_ALARMA
SONAR_ALARMA:
	SBI PORTC, PC5
	JMP CONTINUAR_AFTER_ALARMA
CALLAR_ALARMA:
	CBI PORTC, PC5
CONTINUAR_AFTER_ALARMA:
	OUT PORTD, R16
	OUT PORTB, R17
IGNORAR_DISPLAYS:
	JMP LOOP

//########################################################################
//				INICIALIZACIÓN DE LOS REGISTROS QUE SE USAN
//########################################################################

INITIALIZE_TIME:
	LDI R16, 0x00
	STS MINUTE_U, R16
	STS MINUTE_D, R16
	STS HOUR_U, R16
	STS HOUR_D, R16
	STS DAY_D, R16
	STS MONTH_D, R16
	STS YEAR_C, R16
	STS BISIESTO, R16
	STS ALARM_MINUTE, R16
	STS ALARM_MINUTE_U, R16
	STS ALARM_MINUTE_D, R16
	STS ALARM_HOUR, R16
	STS ALARM_HOUR_U, R16
	STS ALARM_HOUR_D, R16
	LDI R16, 1
	STS DAY_U, R16
	STS MONTH_U, R16
	LDI R16, 2
	STS YEAR_D, R16
	STS YEAR_M, R16
	LDI R16, 4
	STS YEAR_U, R16
	LDI R17, 0x00
	STS SECONDS, R17
	STS MINUTE, R17
	STS HOUR, R17
	STS BISIESTO, R17
	LDI R17, 1
	STS DAY, R17
	STS MONTH, R17
	LDI R17, 24
	STS YEAR_LOW, R17
	LDI R17, 20
	STS YEAR_HIGH, R17
	CLR ALTERNADOR_LEDS
	CLR CONTADOR_TIMER0
	LDI ALTERNADOR_DISPLAYS, 1
	LDI MODE, 1
	LDI BANDERA_ALARMA_BOTONES_SEGUNDO, 0B0000_0000
	LDI CONFIGURE, 0B0000_0010
	RET

//########################################################################
//					INICIALIZACION TIMER0 Y TIMER2
//########################################################################

INITIALIZE_TIMER0:
	LDI R16, (1 << CS02)|(1<<CS00)
	OUT TCCR0B, R16

	LDI R16, 61
	OUT TCNT0, R16
	// TIMER0 EN 50 ms
	RET

INITIALIZE_TIMER2:
	LDI R16, (1 << CS22)
	STS TCCR2B, R16

	LDI R16, 69
	STS TCNT2, R16
	// TIMER2 EN 3 ms
	RET

//########################################################################
//						INTERRUPCIÓN DEL TIMER2
//########################################################################

ISR_TIMER2_OVF:
	PUSH R16
	IN R16, SREG
	PUSH R16

	LDI R16, 69
	STS TCNT2, R16

	SBRC ALTERNADOR_DISPLAYS, 4
	RJMP RESETEAR_ALTERNADOR_DISPLAYS
	LSL ALTERNADOR_DISPLAYS
	RJMP NO_RESETEAR_ALTERNADOR_DISPLAYS
RESETEAR_ALTERNADOR_DISPLAYS:
	LDI ALTERNADOR_DISPLAYS, 1
NO_RESETEAR_ALTERNADOR_DISPLAYS:

	POP R16
	OUT SREG, R16
	POP R16
	RETI

//########################################################################
//						INTERRUPCIÓN DEL TIMER0
//########################################################################

ISR_TIMER0_OVF:
	PUSH R16
	IN R16, SREG
	PUSH R16

	LDI R16, 61
	OUT TCNT0, R16

	INC CONTADOR_TIMER0
	CPI CONTADOR_TIMER0, 10
	BRNE IGNORAR_BANDERA
HA_PASADO_500MS:
	CLR CONTADOR_TIMER0
	INC ALTERNADOR_LEDS
	SBRS ALTERNADOR_LEDS, 0
	RJMP IGNORAR_BANDERA
	ORI BANDERA_ALARMA_BOTONES_SEGUNDO, 0B0000_0001
IGNORAR_BANDERA:
	POP R16
	OUT SREG, R16
	POP R16
	RETI

//########################################################################
//						INTERRUPCIÓN DEL PINC
//########################################################################

ISR_PCINT1:
	PUSH R16
	IN R16, SREG
	PUSH R16

	IN R16, PINC
	SBRS R16, PC1
	RJMP SE_PRESIONO_PC1
	SBRS R16, PC2
	RJMP SE_PRESIONO_PC2
	SBRS R16, PC3
	RJMP SE_PRESIONO_PC3
	SBRS R16, PC4
	RJMP SE_PRESIONO_PC4
	RJMP CONTINUAR_PCINT1
SE_PRESIONO_PC4: // INCREMENTAR
	SBRC BANDERA_ALARMA_BOTONES_SEGUNDO, 4
	JMP APAGAR_ALARMA
	SBRC CONFIGURE, 0
	JMP ACTIVAR_SUMA
	SBRS MODE, 3
	JMP CONTINUAR_PCINT1
	SBRC BANDERA_ALARMA_BOTONES_SEGUNDO, 3
	JMP QUITAR_MODO_ALARMA
	JMP PONER_MODO_ALARMA
ACTIVAR_SUMA:
	ORI BANDERA_ALARMA_BOTONES_SEGUNDO, 0B0000_0010
	RJMP CONTINUAR_PCINT1
SE_PRESIONO_PC3: // DECREMENTAR
	SBRC BANDERA_ALARMA_BOTONES_SEGUNDO, 4
	JMP APAGAR_ALARMA
	SBRC CONFIGURE, 0
	JMP ACTIVAR_RESTA
	JMP CONTINUAR_PCINT1
ACTIVAR_RESTA:
	ORI BANDERA_ALARMA_BOTONES_SEGUNDO, 0B0000_0100
	RJMP CONTINUAR_PCINT1
SE_PRESIONO_PC2: // CAMBIO A CONFIGURACIÓN
	SBRC BANDERA_ALARMA_BOTONES_SEGUNDO, 4
	JMP APAGAR_ALARMA
	SBRS CONFIGURE, 0
	RJMP PONER_MODO_CONFIGURE
	SBRS CONFIGURE, 1
	RJMP MOVER_CONFIG_DERECHA
MOVER_CONFIG_IZQUIERDA:
	ANDI CONFIGURE, 0B1111_1101
	ORI CONFIGURE, 0B0000_0100
	RJMP CONTINUAR_PCINT1
MOVER_CONFIG_DERECHA:
	ANDI CONFIGURE, 0B1111_1011
	ORI CONFIGURE, 0B0000_0010
	RJMP CONTINUAR_PCINT1
PONER_MODO_CONFIGURE:
	LDI CONFIGURE, 0B0000_0011
	RJMP CONTINUAR_PCINT1
SE_PRESIONO_PC1: // CAMBIO DE MODO Y SALIDA DE MODO CONFIGURACIÓN
	SBRC BANDERA_ALARMA_BOTONES_SEGUNDO, 4
	JMP APAGAR_ALARMA
	SBRC CONFIGURE, 0
	RJMP QUITAR_MODO_CONFIGURE
	CPI MODE, 0B0000_1000
	BREQ CAMBIAR_A_MODO_HORA
	LSL MODE
	RJMP CONTINUAR_PCINT1
QUITAR_MODO_CONFIGURE:
	ANDI CONFIGURE, 0B1111_1110
	RJMP CONTINUAR_PCINT1
CAMBIAR_A_MODO_HORA:
	LDI MODE, 0B0000_0001
	RJMP CONTINUAR_PCINT1
PONER_MODO_ALARMA:
	ORI BANDERA_ALARMA_BOTONES_SEGUNDO, 0B0000_1000
	RJMP CONTINUAR_PCINT1
QUITAR_MODO_ALARMA:
	ANDI BANDERA_ALARMA_BOTONES_SEGUNDO, 0B1111_0111
	RJMP CONTINUAR_PCINT1
APAGAR_ALARMA:
	ANDI BANDERA_ALARMA_BOTONES_SEGUNDO, 0B1110_1111
	RJMP QUITAR_MODO_ALARMA
CONTINUAR_PCINT1:
	POP R16
	OUT SREG, R16
	POP R16
	RETI

//########################################################################
//						TABLA DE NÚMEROS PARA DISPLAYS
//########################################################################

TABLA: .DB 0x80, 0xF2, 0x48, 0x60, 0x32, 0x24, 0x04, 0xF0, 0x00, 0x20, 0xFE, 0x06, 0x8C, 0x42, 0x0C, 0x1C