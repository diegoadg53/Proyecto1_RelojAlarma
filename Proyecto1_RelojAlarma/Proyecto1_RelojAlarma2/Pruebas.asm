	INC CONTADOR_TIMER0
	CPI CONTADOR_TIMER0, 10 // AQUI
	BRNE IGNORAR_SUMA_SEGUNDO
HA_PASADO_500MS:
	CLR CONTADOR_TIMER0
	INC ALTERNADOR_LEDS
	SBRS ALTERNADOR_LEDS, 1
	RJMP IGNORAR_SUMA_SEGUNDO

// DE AQUI PARA ABAJO SE MOVERIA AL MAIN LOOP
HA_PASADO_SEGUNDO:
	LDS R17, SECONDS
	INC R17
	CPI R17, 60 // AQUI
	BREQ HA_PASADO_MINUTO
	JMP NO_HA_PASADO_MINUTO
HA_PASADO_MINUTO:
	CLR R17
	STS SECONDS, R17
	LDS R17, MINUTE
	LDS R16, MINUTE_U
	INC R16
	INC R17
	CPI R16, 10 // AQUI
	BREQ HA_PASADO_10_MINUTO
	JMP NO_HA_PASADO_10_MINUTO
HA_PASADO_10_MINUTO:
	CLR R16
	STS MINUTE_U, R16
	LDS R16, MINUTE_D
	INC R16
	CPI R16, 6 // AQUI
	BREQ HA_PASADO_HORA
	JMP NO_HA_PASADO_HORA
HA_PASADO_HORA:
	CLR R17
	STS MINUTE, R17
	CLR R16
	STS MINUTE_D, R16
	LDS R17, HOUR
	LDS R16, HOUR_U
	INC R17
	INC R16
	CPI R17, 24 // AQUI
	BREQ HA_PASADO_DIA
	JMP NO_HA_PASADO_DIA
HA_PASADO_DIA:
	CLR R16
	STS HOUR_U, R16
	CLR R17
	STS HOUR, R17
	LDS R16, HOUR_D
	CLR R16
	STS HOUR_D, R16
	LDS R17, DAY
	INC R17
	LDS R16, MONTH
	CPI R16, 1 // AQUI
	BREQ ES_MES_REGULAR
	CPI R16, 2 // AQUI
	BREQ ES_FEBRERO
	CPI R16, 3 // AQUI
	BREQ ES_MES_REGULAR
	CPI R16, 4 // AQUI
	BREQ ES_MES_IRREGULAR
	CPI R16, 5 // AQUI
	BREQ ES_MES_REGULAR
	CPI R16, 6 // AQUI
	BREQ ES_MES_IRREGULAR
	CPI R16, 7 // AQUI
	BREQ ES_MES_REGULAR
	CPI R16, 8 // AQUI
	BREQ ES_MES_REGULAR
	CPI R16, 9 // AQUI
	BREQ ES_MES_IRREGULAR
	CPI R16, 10 // AQUI
	BREQ ES_MES_REGULAR
	CPI R16, 11 // AQUI
	BREQ ES_MES_IRREGULAR
	CPI R16, 12 // AQUI
	BREQ ES_MES_REGULAR
ES_FEBRERO:
	STS DAY, R17
	LDS R17, BISIESTO
	CPI R17, 0 // AQUI NO ES NECESARIO
	BRNE NO_ES_BISIESTO
ES_BISIESTO:
	LDS R17, DAY
	CPI R17, 30 // AQUI
	BREQ HA_PASADO_MES
	JMP NO_HA_PASADO_MES
NO_ES_BISIESTO:
	LDS R17, DAY
	CPI R17, 29 // AQUI
	BREQ HA_PASADO_MES
	JMP NO_HA_PASADO_MES
ES_MES_IRREGULAR:
	CPI R17, 31 // AQUI
	BREQ HA_PASADO_MES
	JMP NO_HA_PASADO_MES
ES_MES_REGULAR:
	CPI R17, 32 // AQUI
	BREQ HA_PASADO_MES
	JMP NO_HA_PASADO_MES
HA_PASADO_MES:
	// EN R17 ESTA DAY
	LDI R16, 1
	STS DAY_U, R16
	CLR R16
	STS DAY_D, R16
	LDI R17, 1
	STS DAY, R17
	LDS R17, MONTH
	INC R17
	CPI R17, 13 // AQUI
	BREQ HA_PASADO_YEAR
	JMP NO_HA_PASADO_YEAR
HA_PASADO_YEAR:
	LDI R17, 1
	STS MONTH, R17
	LDI R16, 1
	STS MONTH_U, R16
	CLR R16
	STS MONTH_D, R16
	LDS R17, BISIESTO
	INC R17
	CPI R17, 4 // AQUI NO ES NECESARIO
	BRNE NO_CAMBIAR_BISIESTO
CAMBIAR_BISIESTO:
	CLR R17
NO_CAMBIAR_BISIESTO:
	STS BISIESTO, R17
	LDS R17, YEAR_LOW
	LDS R16, YEAR_U
	INC R17
	INC R16
	CPI R16, 10 // AQUI
	BREQ HA_PASADO_10_YEAR
	JMP NO_HA_PASADO_10_YEAR
HA_PASADO_10_YEAR:
	CLR R16
	STS YEAR_U, R16
	LDS R16, YEAR_D
	INC R16
	CPI R16, 10 // AQUI
	BREQ HA_PASADO_100_YEAR
	JMP NO_HA_PASADO_100_YEAR
HA_PASADO_100_YEAR:
	CLR R16
	STS YEAR_D, R16
	CLR R17
	STS YEAR_LOW, R17
	LDS R17, YEAR_HIGH
	INC R17
	LDS R16, YEAR_C
	INC R16
	CPI R16, 10 // AQUI NO ES NECESARIO
	BRNE NO_HA_PASADO_1000_YEAR
HA_PASADO_1000_YEAR:
	CLR R16
	STS YEAR_C, R16
	LDS R16, YEAR_M
	INC R16
	CPI R16, 10 // AQUI NO ES NECESARIO
	BRNE NO_HA_PASADO_10000_YEAR
HA_PASADO_10000_YEAR:
	CLR R16
	STS YEAR_M, R16
	CLR R17
	STS YEAR_HIGH, R17
	STS BISIESTO, R17
	JMP IGNORAR_SUMA_SEGUNDO
NO_HA_PASADO_10000_YEAR:
	STS YEAR_M, R16
	STS YEAR_HIGH, R17
	JMP IGNORAR_SUMA_SEGUNDO
NO_HA_PASADO_1000_YEAR:
	STS YEAR_C, R16
	STS YEAR_HIGH, R17
	JMP IGNORAR_SUMA_SEGUNDO
NO_HA_PASADO_100_YEAR:
	STS YEAR_D, R16
	STS YEAR_LOW, R17
	JMP IGNORAR_SUMA_SEGUNDO
NO_HA_PASADO_10_YEAR:
	STS YEAR_U, R16
	STS YEAR_LOW, R17
	JMP IGNORAR_SUMA_SEGUNDO
NO_HA_PASADO_YEAR:
	LDS R16, MONTH_U
	INC R16
	CPI R16, 10 // AQUI NO ES NECESARIO
	BRNE NO_HA_PASADO_10_MES
HA_PASADO_10_MES:
	CLR R16
	STS MONTH_U, R16
	LDS R16, MONTH_D
	INC R16
	STS MONTH, R17
	STS MONTH_D, R16
	JMP IGNORAR_SUMA_SEGUNDO
NO_HA_PASADO_10_MES:
	STS MONTH_U, R16
	STS MONTH, R17
	JMP IGNORAR_SUMA_SEGUNDO
NO_HA_PASADO_MES:
	LDS R16, DAY_U
	INC R16
	CPI R16, 10 // AQUI NO ES NECESARIO
	BRNE NO_HA_PASADO_10_DIA
HA_PASADO_10_DIA:
	CLR R16
	STS DAY_U, R16
	LDS R16, DAY_D
	INC R16
	STS DAY, R17
	STS DAY_D, R16
	RJMP IGNORAR_SUMA_SEGUNDO
NO_HA_PASADO_10_DIA:
	STS DAY, R17
	STS DAY_U, R16
	RJMP IGNORAR_SUMA_SEGUNDO
NO_HA_PASADO_DIA:
	CPI R16, 10 // AQUI NO ES NECESARIO
	BRNE NO_HA_PASADO_10_HORA
HA_PASADO_10_HORA:
	CLR R16
	STS HOUR_U, R16
	LDS R16, HOUR_D
	INC R16
	STS HOUR, R17
	STS HOUR_D, R16
	RJMP IGNORAR_SUMA_SEGUNDO
NO_HA_PASADO_10_HORA:
	STS HOUR, R17
	STS HOUR_U, R16
	RJMP IGNORAR_SUMA_SEGUNDO
NO_HA_PASADO_HORA:
	STS MINUTE, R17
	STS MINUTE_D, R16
	RJMP IGNORAR_SUMA_SEGUNDO
NO_HA_PASADO_10_MINUTO:
	STS MINUTE, R17
	STS MINUTE_U, R16
	RJMP IGNORAR_SUMA_SEGUNDO
NO_HA_PASADO_MINUTO:
	STS SECONDS, R17
IGNORAR_SUMA_SEGUNDO:


//###############################################3
//				LEDS EN MEDIO
//###################################################
LEDS_EN_MEDIO:
	SBI PORTC, PC0			//TRANSISTOR DE OTRAS LEDS
	SBI PORTB, PB5			// DIG 1
	CBI PORTB, PB4			// DIG 2
	SBI PORTB, PB3			// DIG 3
	SBI PORTB, PB2			// DIG 4
	IN R16, PORTD
	ORI R16, 0b1111_1100
	IN R17, PORTB
	ORI R17, 0b0000_0011
	SBRC ALTERNADOR_LEDS, 1
	ANDI R17, 0b1111_1101
	OUT PORTD, R16
	OUT PORTB, R17
	JMP IGNORAR_DISPLAYS




	ISR_PCINT1:
	PUSH R16
	IN R16, SREG
	PUSH R16

	IN R16, PINC
	SBRS R16, PC1
	RJMP SE_PRESIONO_PC1
	ORI BANDERA_SEGUNDO_Y_BOTONES, 0B0000_0010
	SBRS R16, PC2
	RJMP SE_PRESIONO_PC2
	ORI BANDERA_SEGUNDO_Y_BOTONES, 0B0000_0100
	SBRS R16, PC3
	RJMP SE_PRESIONO_PC3
	ORI BANDERA_SEGUNDO_Y_BOTONES, 0B0000_1000
	SBRS R16, PC4
	RJMP SE_PRESIONO_PC4
	ORI BANDERA_SEGUNDO_Y_BOTONES, 0B0001_0000
	RJMP CONTINUAR_PCINT1
SE_PRESIONO_PC4: // INCREMENTAR
	SBRS BANDERA_SEGUNDO_Y_BOTONES, PC4
	RJMP CONTINUAR_PCINT1

	RJMP CONTINUAR_PCINT1
SE_PRESIONO_PC3: // DECREMENTAR
	RJMP CONTINUAR_PCINT1
SE_PRESIONO_PC2: // CAMBIO A CONFIGURACIсN
	RJMP CONTINUAR_PCINT1
SE_PRESIONO_PC1:
	SBRS BANDERA_SEGUNDO_Y_BOTONES, PC1
	RJMP CONTINUAR_PCINT1
	CPI MODE, 0B0000_1000
	BREQ CAMBIAR_A_MODO_HORA
	LSL MODE
	RJMP CONTINUAR_PCINT1
CAMBIAR_A_MODO_HORA:
	LDI MODE, 0B0000_0001
CONTINUAR_PCINT1:
	POP R16
	OUT SREG, R16
	POP R16
	RETI



//########################################################################
//						MODO CONFIGURACION
//########################################################################


CONFIG_ALARMA:
	SBRC CONFIGURE, 1
	JMP CONFIG_ALARMA_MIN
CONFIG_ALARMA_HORA:
	SBRC BANDERA_ALARMA_BOTONES_SEGUNDO, 1
	JMP INCREMENTAR_ALARMA_HORA
	SBRC BANDERA_ALARMA_BOTONES_SEGUNDO, 2
	JMP DECREMENTAR_ALARMA_HORA
	JMP MUESTREO_DISPLAYS
INCREMENTAR_ALARMA_HORA:
	ANDI BANDERA_ALARMA_BOTONES_SEGUNDO, 0B1111_1101
	LDS R17, ALARM_HOUR
	LDS R16, ALARM_HOUR_U
	INC R17
	CPI R17, 24
	BREQ ALARMA_HORA_DE_24_A_0
	JMP ALARMA_HORA_NO_DE_24_A_0
ALARMA_HORA_DE_24_A_0:
	CLR R16
	STS ALARM_HOUR_U, R16
	STS ALARM_HOUR_D, R16
	CLR R17
	STS ALARM_HOUR, R17
	JMP MUESTREO_DISPLAYS
ALARMA_HORA_NO_DE_24_A_0:
	INC R16
	CPI R16, 10
	BREQ AUMENTO_DECENA_ALARMA_HORA
	JMP NO_AUMENTO_DECENA_ALARMA_HORA
AUMENTO_DECENA_ALARMA_HORA:
	CLR R16
	STS ALARM_HOUR_U, R16
	LDS R16, ALARM_HOUR_D
	INC R16
	STS ALARM_HOUR_D, R16
	STS ALARM_HOUR, R17
	JMP MUESTREO_DISPLAYS
NO_AUMENTO_DECENA_ALARMA_HORA:
	STS ALARM_HOUR_U, R16
	STS ALARM_HOUR, R17
	JMP MUESTREO_DISPLAYS
DECREMENTAR_ALARMA_HORA:
	ANDI BANDERA_ALARMA_BOTONES_SEGUNDO, 0B1111_1011
	LDS R17, ALARM_HOUR
	LDS R16, ALARM_HOUR_U
	DEC R17
	CPI R17, -1
	BREQ ALARMA_HORA_DE_0_A_23
	JMP ALARMA_HORA_NO_DE_0_A_23
ALARMA_HORA_DE_0_A_23:
	LDI R16, 3
	STS ALARM_HOUR_U, R16
	LDI R16, 2
	STS ALARM_HOUR_D, R16
	LDI R17, 23
	STS ALARM_HOUR, R17
	JMP MUESTREO_DISPLAYS
ALARMA_HORA_NO_DE_0_A_23:
	DEC R16
	CPI R16, -1
	BREQ REDUCCION_DECENA_ALARMA_HORA
	JMP NO_REDUCCION_DECENA_ALARMA_HORA
REDUCCION_DECENA_ALARMA_HORA:
	LDI R16, 9
	STS ALARM_HOUR_U, R16
	LDS R16, ALARM_HOUR_D
	DEC R16
	STS ALARM_HOUR_D, R16
	STS ALARM_HOUR, R17
	JMP MUESTREO_DISPLAYS
NO_REDUCCION_DECENA_ALARMA_HORA:
	STS ALARM_HOUR_U, R16
	STS ALARM_HOUR, R17
	JMP MUESTREO_DISPLAYS
CONFIG_ALARMA_MIN:
	SBRC BANDERA_ALARMA_BOTONES_SEGUNDO, 1
	JMP INCREMENTAR_ALARMA_MIN
	SBRC BANDERA_ALARMA_BOTONES_SEGUNDO, 2
	JMP DECREMENTAR_ALARMA_MIN
	JMP MUESTREO_DISPLAYS
INCREMENTAR_ALARMA_MIN:
	ANDI BANDERA_ALARMA_BOTONES_SEGUNDO, 0B1111_1101
	LDS R17, ALARM_MINUTE
	LDS R16, ALARM_MINUTE_U
	INC R17
	CPI R17, 60
	BREQ ALARMA_MIN_DE_60_A_0
	JMP ALARMA_MIN_NO_DE_60_A_0
ALARMA_MIN_DE_60_A_0:
	CLR R16
	STS ALARM_MINUTE_U, R16
	STS ALARM_MINUTE_D, R16
	CLR R17
	STS ALARM_MINUTE, R17
	JMP MUESTREO_DISPLAYS
ALARMA_MIN_NO_DE_60_A_0:
	INC R16
	CPI R16, 10
	BREQ AUMENTO_DECENA_ALARMA_MIN
	JMP NO_AUMENTO_DECENA_ALARMA_MIN
AUMENTO_DECENA_ALARMA_MIN:
	CLR R16
	STS ALARM_MINUTE_U, R16
	LDS R16, ALARM_MINUTE_D
	INC R16
	STS ALARM_MINUTE_D, R16
	STS ALARM_MINUTE, R17
	JMP MUESTREO_DISPLAYS
NO_AUMENTO_DECENA_ALARMA_MIN:
	STS ALARM_MINUTE_U, R16
	STS ALARM_MINUTE, R17
	JMP MUESTREO_DISPLAYS
DECREMENTAR_ALARMA_MIN:
	ANDI BANDERA_ALARMA_BOTONES_SEGUNDO, 0B1111_1011
	LDS R17, ALARM_MINUTE
	LDS R16, ALARM_MINUTE_U
	DEC R17
	CPI R17, -1
	BREQ ALARMA_MIN_DE_0_A_60
	JMP ALARMA_MIN_NO_DE_0_A_60
ALARMA_MIN_DE_0_A_60:
	LDI R16, 9
	STS ALARM_MINUTE_U, R16
	LDI R16, 5
	STS ALARM_MINUTE_D, R16
	LDI R17, 59
	STS ALARM_MINUTE, R17
	JMP MUESTREO_DISPLAYS
ALARMA_MIN_NO_DE_0_A_60:
	DEC R16
	CPI R16, -1
	BREQ REDUCCION_DECENA_ALARMA_MIN
	JMP NO_REDUCCION_DECENA_ALARMA_MIN
REDUCCION_DECENA_ALARMA_MIN:
	LDI R16, 9
	STS ALARM_MINUTE_U, R16
	LDS R16, ALARM_MINUTE_D
	DEC R16
	STS ALARM_MINUTE_D, R16
	STS ALARM_MINUTE, R17
	JMP MUESTREO_DISPLAYS
NO_REDUCCION_DECENA_ALARMA_MIN:
	STS ALARM_MINUTE_U, R16
	STS ALARM_MINUTE, R17
	JMP MUESTREO_DISPLAYS

